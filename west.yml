## west.yml
```yaml
manifest:
  self:
    path: MoDriverProject

  remotes:
    - name: github
      url-base: https://github.com
    - name: origin 
      url-base: ssh://git@github.com/zagerx

  defaults:
    remote: origin
    revision: master

  projects:
    - name: MoDriver_HW_Control
      path: HardWare/ControlBoard
      remote: origin
      revision: master
    - name: MoDriver_HW_Driver
      path: HardWare/DriverBoard
      remote: origin
      revision: master
    - name: KicadLib
      path: HardWare/KicadLib
      remote: origin
      revision: master    


    
```
